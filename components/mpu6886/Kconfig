## components/mpu6886/Kconfig
```kconfig
menu "MPU6886 Sensor"

    config MPU6886_I2C_PORT
        int "MPU6886 I2C Port"
        range 0 1
        default 0
        help
            MPU6886 I2C Port

    config MPU6886_I2C_ADDRESS
        hex "MPU6886 I2C Address"
        range 0 0x7F
        default 0x68
        help
            MPU6886 I2C Address

endmenu
```

## components/wire/Kconfig
```kconfig
menu "Wire I2C Library"

    menu "I2C Port 0"

        config WIRE_PORT0_I2C_SCL_GPIO
            int "Port 0 SCL GPIO"
            range 0 36
            default 22
            help
                Wire Port 0 SCL GPIO number

        config WIRE_PORT0_I2C_SDA_GPIO
            int "Port 0 SDA GPIO"
            range 0 36
            default 21
            help
                Wire Port 0 SDA GPIO number

        config WIRE_PORT0_CLOCK_SPEED
            int "Port 0 Clock Speed [Hz]"
            range 0 1000000
            default 100000
            help
                Wire Port 0 Clock Speed

    endmenu 

    menu "I2C Port 1"

        config WIRE_PORT1_I2C_SCL_GPIO
            int "Port 1 SCL GPIO"
            range 0 36
            default 33
            help
                Wire Port 1 SCL GPIO number

        config WIRE_PORT1_I2C_SDA_GPIO
            int "Port 1 SDA GPIO"
            range 0 36
            default 32
            help
                Wire Port 1 SDA GPIO number

        config WIRE_PORT1_CLOCK_SPEED
            int "Port 1 Clock Speed [Hz]"
            range 0 1000000
            default 100000
            help
                Wire Port 1 Clock Speed

    endmenu 

endmenu
```

## sdkconfig.defaults
```kconfig
# Wire I2C Library
CONFIG_WIRE_PORT0_I2C_SCL_GPIO=22
CONFIG_WIRE_PORT0_I2C_SDA_GPIO=21
CONFIG_WIRE_PORT0_CLOCK_SPEED=100000
CONFIG_WIRE_PORT1_I2C_SCL_GPIO=33
CONFIG_WIRE_PORT1_I2C_SDA_GPIO=32
CONFIG_WIRE_PORT1_CLOCK_SPEED=100000

# MPU6886
CONFIG_MPU6886_I2C_PORT=0
CONFIG_MPU6886_I2C_ADDRESS=0x68
```
